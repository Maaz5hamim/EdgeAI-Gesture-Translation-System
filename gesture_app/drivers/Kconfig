## gesture_app_cnn/drivers/lsm6ds3/Kconfig
```kconfig
menuconfig LSM6DS3
	bool "LSM6DS3 I2C/SPI accelerometer and gyroscope Chip"
	default y
	depends on DT_HAS_ST_LSM6DS3_ENABLED
	select I2C if $(dt_compat_on_bus,$(DT_COMPAT_ST_LSM6DS3),i2c)
	select SPI if $(dt_compat_on_bus,$(DT_COMPAT_ST_LSM6DS3),spi)
	help
	  Enable driver for LSM6DS3 accelerometer and gyroscope sensor.

if LSM6DS3

choice LSM6DS3_TRIGGER_MODE
	prompt "Trigger mode"
	help
	  Specify the type of triggering to be used by the driver.

config LSM6DS3_TRIGGER_NONE
	bool "No trigger"

config LSM6DS3_TRIGGER_GLOBAL_THREAD
	bool "Use global thread"
	depends on GPIO
	depends on $(dt_compat_any_has_prop,$(DT_COMPAT_ST_LSM6DS3),irq-gpios)
	select LSM6DS3_TRIGGER

config LSM6DS3_TRIGGER_OWN_THREAD
	bool "Use own thread"
	depends on GPIO
	depends on $(dt_compat_any_has_prop,$(DT_COMPAT_ST_LSM6DS3),irq-gpios)
	select LSM6DS3_TRIGGER

endchoice

config LSM6DS3_TRIGGER
	bool

config LSM6DS3_THREAD_PRIORITY
	int "Thread priority"
	depends on LSM6DS3_TRIGGER_OWN_THREAD
	default 10

config LSM6DS3_THREAD_STACK_SIZE
	int "Thread stack size"
	depends on LSM6DS3_TRIGGER_OWN_THREAD
	default 1024

config LSM6DS3_ENABLE_TEMP
	bool "Temperature"

config LSM6DS3_SENSORHUB
	bool "I2C sensorhub feature"

config LSM6DS3_GYRO_FS
	int "Gyroscope full-scale range"
	default 0

config LSM6DS3_GYRO_ODR
	int "Gyroscope Output data rate frequency"
	range 0 10
	default 0

config LSM6DS3_ACCEL_FS
	int "Accelerometer full-scale range"
	default 0

config LSM6DS3_ACCEL_ODR
	int "Accelerometer Output data rate frequency"
	range 0 11
	default 0

endif # LSM6DS3
```

## gesture_app_rf/build/gesture_app_rf/Kconfig/boards/Kconfig.defconfig
```kconfig
# Load Zephyr board defconfig descriptions.
osource "/opt/nordic/ncs/v3.2.1/zephyr/boards/nordic/nrf54l15dk/Kconfig.defconfig"
```
