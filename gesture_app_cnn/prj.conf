## prj.conf
```kconfig
# ==========================================
# 1. HARDWARE, SENSORS, & GPIO
# ==========================================
CONFIG_I2C=y
CONFIG_SENSOR=y
CONFIG_LSM6DS3=y
# CONFIG_LSM6DS3_TRIGGER_GLOBAL_THREAD=y
CONFIG_GPIO=y
CONFIG_LSM6DS3_TRIGGER_OWN_THREAD=y
CONFIG_LSM6DS3_THREAD_PRIORITY=10

# ==========================================
# 2. C++ AND TINYML (TENSORFLOW)
# ==========================================
CONFIG_CPP=y
CONFIG_STD_CPP17=y
CONFIG_TENSORFLOW_LITE_MICRO=y
CONFIG_FPU=y
CONFIG_CMSIS_DSP=y
CONFIG_CMSIS_NN=y
CONFIG_CBPRINTF_FP_SUPPORT=y

# ==========================================
# 3. BLUETOOTH CORE
# ==========================================
CONFIG_BT=y
CONFIG_BT_PERIPHERAL=y
CONFIG_BT_DEVICE_NAME="EdgeAI Gesture Translation System"
CONFIG_BT_DEVICE_APPEARANCE=961
CONFIG_BT_MAX_CONN=1
CONFIG_BT_MAX_PAIRED=5
CONFIG_BT_CONN_CTX=y

# ==========================================
# 4. BLUETOOTH HID & SERVICES
# ==========================================
CONFIG_BT_HIDS=y
CONFIG_BT_HIDS_MAX_CLIENT_COUNT=1
CONFIG_BT_HIDS_DEFAULT_PERM_RW_ENCRYPT=y
CONFIG_BT_HIDS_INPUT_REP_MAX=1

CONFIG_BT_BAS=y
CONFIG_BT_DIS=y
CONFIG_BT_DIS_PNP=y
CONFIG_BT_DIS_PNP_VID_SRC=2
CONFIG_BT_DIS_PNP_VID=0x1915
CONFIG_BT_DIS_PNP_PID=0x0001
CONFIG_BT_DIS_PNP_VER=0x0100

# ==========================================
# 5. BLUETOOTH SECURITY & BONDING (iOS/OSX COMPATIBILITY)
# ==========================================
CONFIG_BT_SMP=y
CONFIG_BT_BONDABLE=y
CONFIG_BT_BONDING_REQUIRED=n
CONFIG_BT_SMP_SC_ONLY=n
CONFIG_BT_SMP_SC_PAIR_ONLY=n
CONFIG_BT_SMP_ALLOW_UNAUTH_OVERWRITE=y
CONFIG_BT_GATT_AUTO_SEC_REQ=n
CONFIG_BT_AUTO_PHY_UPDATE=n

# ==========================================
# 6. FLASH & SETTINGS (FOR SAVING BLUETOOTH PAIRINGS)
# ==========================================
CONFIG_BT_SETTINGS=y
CONFIG_FLASH=y
CONFIG_FLASH_PAGE_LAYOUT=y
CONFIG_FLASH_MAP=y
CONFIG_NVS=y
CONFIG_SETTINGS=y
CONFIG_SETTINGS_NVS=y

# ==========================================
# 7. BLUETOOTH MEMORY POOLS
# ==========================================
CONFIG_BT_GATT_UUID16_POOL_SIZE=40
CONFIG_BT_GATT_CHRC_POOL_SIZE=20
CONFIG_BT_ATT_TX_COUNT=5

# ==========================================
# 8. SYSTEM STACKS & HEAP
# ==========================================
CONFIG_MAIN_STACK_SIZE=8192
CONFIG_SYSTEM_WORKQUEUE_STACK_SIZE=4096
CONFIG_HEAP_MEM_POOL_SIZE=8192

# ==========================================
# 9. LOGGING & DEBUG
# ==========================================
CONFIG_LOG=y
# CONFIG_LOG_BUFFER_SIZE=4096
# CONFIG_LOG_MODE_IMMEDIATE=y
# CONFIG_LOG_PRINTK=y
# Uncomment below if you need deep Bluetooth debugging
# CONFIG_LOG_BACKEND_UART=y
# CONFIG_BT_LOG_LEVEL_WRN=y
```

## src/main.cpp
```c
#include "main_functions.hpp"
#include <zephyr/logging/log.h>

LOG_MODULE_REGISTER(gesture_app, LOG_LEVEL_INF);

int main(int argc, char *argv[])
{
	TfLiteStatus setup_status = setup();
	if (setup_status != kTfLiteOk) {
        LOG_ERR("Setup Failed.\n");
        return -1; 
    }
	while (true) {
		loop();
	}
}
```

## src/ble_keyboard.h
```c
#ifndef BLE_KEYBOARD_H
#define BLE_KEYBOARD_H

#include <stdbool.h>

#ifdef __cplusplus
extern "C" {
#endif

typedef enum {
    GESTURE_NONE = 0,
    GESTURE_SWIPE_UP,
    GESTURE_SWIPE_DOWN,
    GESTURE_SWIPE_LEFT,
    GESTURE_SWIPE_RIGHT,
    GESTURE_COUNT
} gesture_type_t;

// Initialization function 
int ble_keyboard_init(void);

// Existing API to submit gestures to BLE queue
int gesture_submit(gesture_type_t type, float confidence);
int gesture_submit_simple(gesture_type_t type);
bool gesture_hid_is_ready(void);

#ifdef __cplusplus
}
#endif

#endif // BLE_KEYBOARD_H
```

## src/constants.hpp
```c
#ifndef CONSTANTS_H_
#define CONSTANTS_H_

/* The number of time-steps in one "clip" (the window length) */
constexpr int kWindowSize = 100;

/* The number of sensor features (3 Accel + 3 Gyro) */
constexpr int kFeatureCount = 6;

/* Total length of the flattened input tensor (100 * 6 = 768) */
constexpr int kMaxInputLength = kWindowSize * kFeatureCount;

/* The expected IMU sample frequency in Hz */
const float kTargetHz = 104.0f;

const int kMotionThreshold = 32;
const int kMotionDuration = 1;

/* Gesture classification settings */
constexpr int kGestureCount = 8;
/* What gestures are supported. */
inline const char* kGestureNames[] = {
    "UP", 
    "DOWN", 
    "LEFT", 
    "RIGHT", 
    "TAP", 
    "DOUBLE_TAP", 
    "STATIC", 
    "NONE"
};
constexpr int kSlideUp = 0;
constexpr int kSlideDown = 1;
constexpr int kSlideLeft = 2;
constexpr int kSlideRight = 3;

constexpr float kDetectionThreshold = 0.6f;



#endif /* CONSTANTS_H_ */
```

## src/gesture_model.hpp
```c
/* Auto-generated model data for nRF54L15 */
#ifndef GESTURE_MODEL_H_
#define GESTURE_MODEL_H_

extern const unsigned char gesture_model_data[];
extern const unsigned int gesture_model_len;

#endif /* GESTURE_MODEL_H_ */
```

## src/imu_handler.cpp
```c
#include "imu_handler.hpp"
#include "constants.hpp"
#include <zephyr/kernel.h>
#include <zephyr/device.h>
#include <zephyr/drivers/sensor.h>
#include <math.h>
#include <zephyr/logging/log.h>
#include <stdio.h>
#include <string.h>
#include <zephyr/drivers/gpio.h>
#include <zephyr/drivers/i2c.h>

LOG_MODULE_REGISTER(imu_handler, LOG_LEVEL_INF);

#define BUFLEN 300

int begin_index = 0;
const struct device *const sensor = DEVICE_DT_GET_ONE(st_lsm6ds3);

float buf_accel_x[BUFLEN] = { 0.0f };
float buf_accel_y[BUFLEN] = { 0.0f };
float buf_accel_z[BUFLEN] = { 0.0f };
float buf_gyro_x[BUFLEN] = { 0.0f };
float buf_gyro_y[BUFLEN] = { 0.0f };
float buf_gyro_z[BUFLEN] = { 0.0f };

K_SEM_DEFINE(gesture_trigger_sem, 0, 1);
const struct i2c_dt_spec i2c_bus = I2C_DT_SPEC_GET(DT_NODELABEL(lsm6ds3));
const struct gpio_dt_spec irq_pin = GPIO_DT_SPEC_GET(DT_NODELABEL(lsm6ds3), irq_gpios);

#define STACKSIZE 1024
#define PRIORITY 7

void capture_sample() {
    struct sensor_value accel[3];
    struct sensor_value gyro[3];

    sensor_sample_fetch(sensor);
    sensor_channel_get(sensor, SENSOR_CHAN_ACCEL_XYZ, accel);
    sensor_channel_get(sensor, SENSOR_CHAN_GYRO_XYZ, gyro);

    buf_accel_x[begin_index] = (float)sensor_value_to_double(&accel[0]);
    buf_accel_y[begin_index] = (float)sensor_value_to_double(&accel[1]);
    buf_accel_z[begin_index] = (float)sensor_value_to_double(&accel[2]);
	buf_gyro_x[begin_index] = (float)sensor_value_to_double(&gyro[0]);    
	buf_gyro_y[begin_index] = (float)sensor_value_to_double(&gyro[1]);    
	buf_gyro_z[begin_index] = (float)sensor_value_to_double(&gyro[2]);   
	
    begin_index = (begin_index + 1) % BUFLEN;
}

void sampling_thread_impl(void *, void *, void *) {
    while (1) {
        capture_sample();
        // 100Hz sampling
        k_msleep(10); 
    }
}

K_THREAD_DEFINE(sampling_tid, STACKSIZE, sampling_thread_impl, NULL, NULL, NULL, PRIORITY, 0, 0);

void motion_interrupt_handler(const struct device *dev, const struct sensor_trigger *trigger) {
	sensor_sample_fetch(dev);
    k_sem_give(&gesture_trigger_sem); 
}

int configure_motion_threshold(uint8_t threshold, uint8_t duration) {
	if (!device_is_ready(i2c_bus.bus)) {
        LOG_ERR("I2C bus not ready");
        return -ENODEV;
    }

    // Enable embedded functions
    uint8_t ctrl10_c[] = {0x19, 0x3C};
    i2c_write_dt(&i2c_bus, ctrl10_c, 2);
    
    // Enable interrupts with HPF
    uint8_t tap_cfg[] = {0x58, 0x90}; 
    if (i2c_write_dt(&i2c_bus, tap_cfg, 2) < 0) {
        LOG_ERR("Failed to write TAP_CFG");
        return -EIO;
    }
    
    // Set wake-up threshold
    uint8_t wu_ths[] = {0x5B, (threshold & 0x3F)};
    if (i2c_write_dt(&i2c_bus, wu_ths, 2) < 0) {
        LOG_ERR("Failed to write WAKE_UP_THS");
        return -EIO;
    }
    
    // Set wake-up duration
    uint8_t dur_val = (duration & 0x03) << 5;
    uint8_t dur_cfg[] = {0x5C, dur_val};
    if (i2c_write_dt(&i2c_bus, dur_cfg, 2) < 0) {
        LOG_ERR("Failed to write WAKE_UP_DUR");
        return -EIO;
    }
    
    // Disable data-ready interrupts on INT1
    // INT1_CTRL (0x0D): Set all bits to 0
    uint8_t int1_ctrl[] = {0x0D, 0x00};
    if (i2c_write_dt(&i2c_bus, int1_ctrl, 2) < 0) {
        LOG_ERR("Failed to write INT1_CTRL");
        return -EIO;
    }
    
    //Route ONLY wake-up interrupt to INT1
    uint8_t md1_cfg[] = {0x5E, 0x20};
    if (i2c_write_dt(&i2c_bus, md1_cfg, 2) < 0) {
        LOG_ERR("Failed to write MD1_CFG");
        return -EIO;
    }
    
    return 0;
}

bool SetupIMU()
{
	LOG_INF("IMU Setup Initialization");

	struct sensor_value odr;
	odr.val1 = (int32_t)kTargetHz; 
	odr.val2 = 0;

	if (!device_is_ready(sensor)) {
		LOG_ERR("%s: device not ready.\n", sensor->name);
		return false;
	}

	LOG_INF("IMU detected, name: %s\n", sensor->name);

	// Set Accelerometer to pulse at TargetHz
	if (sensor_attr_set(sensor, SENSOR_CHAN_ACCEL_XYZ,
						SENSOR_ATTR_SAMPLING_FREQUENCY, &odr) < 0) {
		LOG_ERR("Cannot set accelerometer ODR");
		return false;
	}

	LOG_INF("Accelerometer ODR set to %f Hz", (double)kTargetHz);

	// Set Gyroscope to pulse at TargetHz
	if (sensor_attr_set(sensor, SENSOR_CHAN_GYRO_XYZ, 
						SENSOR_ATTR_SAMPLING_FREQUENCY, &odr) < 0) {
		LOG_ERR("Cannot set gyroscope ODR");
		return false;
	}	

	LOG_INF("Gyroscope ODR set to %f Hz", (double)kTargetHz);

	struct sensor_trigger trig;
    trig.type = SENSOR_TRIG_DELTA;      // Trigger on change (motion)
    trig.chan = SENSOR_CHAN_ACCEL_XYZ; // Monitor the accelerometer

	int err;

    // Set the trigger
	err = sensor_trigger_set(sensor, &trig, motion_interrupt_handler);
    if (err < 0) {
        LOG_ERR("Could not set sensor trigger: %d", err);
		return false;
    }

	LOG_INF("IMU trigger initialized");

	// Set the imu motion threshold
	err = configure_motion_threshold(kMotionThreshold, kMotionDuration);
	if (err) {
		LOG_ERR("I2C Manual Config Failed: %d", err);
		return false;
	}

	LOG_INF("Motion threshold and duration set to %d & %d", kMotionThreshold, kMotionDuration);

	LOG_INF("IMU Setup Successful");

	return true;
}

void PrepareInputTensor(float *input) {
    for (int i = 0; i < kWindowSize; i++) {
        int ring_index = (begin_index - kWindowSize + i + BUFLEN) % BUFLEN;
        int offset = i * kFeatureCount;
        input[offset + 0] = buf_accel_x[ring_index];
		input[offset + 1] = buf_accel_y[ring_index];
		input[offset + 2] = buf_accel_z[ring_index];
		input[offset + 3] = buf_gyro_x[ring_index];
		input[offset + 4] = buf_gyro_y[ring_index];
		input[offset + 5] = buf_gyro_z[ring_index];
    }
}

void StreamIMUData() {
    double input[kWindowSize * kFeatureCount];
	printk("START_WINDOW\n"); 

	PrepareModelInput(input);

	for (int i = 0; i < kWindowSize; i++) {
		int offset = i * 6; // 6 channels (kFeatureCount)
		printk("%.4f,%.4f,%.4f,%.4f,%.4f,%.4f\n", 
			input[offset + 0], 
			input[offset + 1], 
			input[offset + 2],
			input[offset + 3], 
			input[offset + 4], 
			input[offset + 5]);

		if (i % 5 == 0) {
        	k_busy_wait(1000);
    	}
	}

	printk("END_WINDOW\n");
}
```

## src/imu_handler.hpp
```c
#ifndef IMU_HANDLER_H_
#define IMU_HANDLER_H_

#include <tensorflow/lite/c/c_api_types.h>
#include <tensorflow/lite/micro/micro_log.h>

extern int begin_index;
extern struct k_sem gesture_trigger_sem;

extern void MotionInterruptHandler(const struct device *dev, struct gpio_callback *cb, uint32_t pins);
extern int ConfigureMotionThreshold(uint8_t threshold, uint8_t duration);
extern bool SetupIMU();
extern bool ReadIMU(float *input, int length);
extern void StreamIMUData();
extern void CaptureSample();
extern void PrepareInputTensor(float *input);

#endif /* IMU_HANDLER_H_ */
```

## src/main_functions.cpp
```c
#include "main_functions.hpp"
#include "output_handler.hpp"
#include "constants.hpp"
#include "gesture_model.hpp"
#include "imu_handler.hpp"
#include <tensorflow/lite/micro/micro_log.h>
#include <tensorflow/lite/micro/micro_interpreter.h>
#include <tensorflow/lite/micro/micro_mutable_op_resolver.h>
#include <tensorflow/lite/schema/schema_generated.h>
#include <zephyr/sys/printk.h>
#include <zephyr/drivers/gpio.h>
#include <zephyr/kernel.h>
#include <zephyr/logging/log.h>

LOG_MODULE_REGISTER(main, LOG_LEVEL_INF);

namespace {
	const tflite::Model *model = nullptr;
	tflite::MicroInterpreter *interpreter = nullptr;
	TfLiteTensor *model_input = nullptr;
	int input_length;

	/* Create an area of memory to use for input, output, and intermediate arrays.
	* The size of this will depend on the model.
	*/
	constexpr int kTensorArenaSize = 100 * 1024;
	static uint8_t tensor_arena[kTensorArenaSize];
} /* namespace */

static double model_input[kWindowSize * kFeatureCount];
static double model_output[kGestureCount];

int run_inference(){
    PrepareModelInput(model_input);

    score(model_input, model_output);

    float processed_scores[kGestureCount];
    for (int i = 0; i < kGestureCount; i++) {
        processed_scores[i] = (float)model_output[i];
    }

    int gesture_index = 7; // Default to "NONE"
    float max_val = 0.0f;

    for (int i = 0; i < kGestureCount; i++) {
        if ((float)model_output[i] > max_val) {
            max_val = (float)model_output[i];
            gesture_index = i;
        }
    }

    // Apply confidence threshold; if too low, force to "NONE"
    if (max_val < kDetectionThreshold) {
        gesture_index = 7; 
    }

    return gesture_index;
}

TfLiteStatus setup()
{
	LOG_INF("Setup Initialization");

	/* Map the model into a usable data structure. */
	model = tflite::GetModel(gesture_model_data);
	if (model->version() != TFLITE_SCHEMA_VERSION) {
		MicroPrintf("Model provided is schema version %d not equal "
				    "to supported version %d.",
				    model->version(), TFLITE_SCHEMA_VERSION);
		return kTfLiteApplicationError;
	}

	LOG_INF("Model loaded");

	/* Pull in only the operation implementations we need.
	 * This relies on a complete list of all the ops needed by this graph.
	 * An easier approach is to just use the AllOpsResolver, but this will
	 * incur some penalty in code space for op implementations that are not
	 * needed by this graph.
	 */
	static tflite::MicroMutableOpResolver < 13 > micro_op_resolver; /* NOLINT */
	micro_op_resolver.AddConv2D();
	micro_op_resolver.AddDepthwiseConv2D();
	micro_op_resolver.AddFullyConnected();
	micro_op_resolver.AddMaxPool2D();
	micro_op_resolver.AddSoftmax();
	micro_op_resolver.AddExpandDims();
	micro_op_resolver.AddReshape();
	micro_op_resolver.AddMean();
	micro_op_resolver.AddMul();
	micro_op_resolver.AddAdd();
	micro_op_resolver.AddSpaceToBatchNd();
	micro_op_resolver.AddBatchToSpaceNd();
	micro_op_resolver.AddReduceMax();

	/* Build an interpreter to run the model with. */
	static tflite::MicroInterpreter static_interpreter(model, micro_op_resolver, tensor_arena, kTensorArenaSize);
	interpreter = &static_interpreter;

	/* Allocate memory from the tensor_arena for the model's tensors. */
	TfLiteStatus allocate_status = interpreter->AllocateTensors();

    if (allocate_status != kTfLiteOk) {
        MicroPrintf("Failed to allocate tensors. Arena is likely too small.\n");
        return kTfLiteApplicationError; 
    }

	LOG_INF("Tensors allocated");

	model_input = interpreter->input(0);
	if (model_input->dims->data[1] != kWindowSize || 
    model_input->dims->data[2] != kFeatureCount) {
    	MicroPrintf("Dimension mismatch! Model expects %dx%d", 
            model_input->dims->data[1], 
			model_input->dims->data[2]);
        return kTfLiteApplicationError;
	}

	LOG_INF("Model validated");

	input_length = model_input->bytes / sizeof(float);

	if (!SetupIMU()) {
		LOG_ERR("Failed to initialize IMU\n");
		return kTfLiteApplicationError;
	}

	return kTfLiteOk;
}

void loop(void)
{
	k_sem_take(&gesture_trigger_sem, K_FOREVER); 

	k_msleep(480);

	int gesture_index = run_inference();

    HandleOutput(gesture_index);

	k_msleep(500); 
	while (k_sem_take(&gesture_trigger_sem, K_NO_WAIT) == 0);

}
```

## src/main_functions.hpp
```c
#ifndef MAIN_FUNCTIONS_H_
#define MAIN_FUNCTIONS_H_

#include <tensorflow/lite/micro/micro_interpreter.h>

/*  Expose a C friendly interface for main functions.*/
#ifdef __cplusplus
extern "C" {
#endif

/* Initializes imu and the model. */
TfLiteStatus setup(void);

/* Runs one iteration of data gathering and inference. This should be called repeatedly from the application code. */
void loop(void);

#ifdef __cplusplus
}
#endif

#endif /* MAIN_FUNCTIONS_H_ */
```
